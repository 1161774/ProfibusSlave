## main/Kconfig.projbuild
```kconfig
menu "Echo RS485 Example Configuration"

    orsource "$IDF_PATH/examples/common_components/env_caps/$IDF_TARGET/Kconfig.env_caps"

    config ECHO_UART_PORT_NUM
        int "UART port number"
        range 0 2 if IDF_TARGET_ESP32 || IDF_TARGET_ESP32S3
        default 2 if IDF_TARGET_ESP32 || IDF_TARGET_ESP32S3
        range 0 1
        default 1
        help
            UART communication port number for the example.
            See UART documentation for available port numbers.

    config ECHO_UART_BAUD_RATE
        int "UART communication speed"
        range 1200 115200
        default 115200
        help
            UART communication speed for Modbus example.

    config ECHO_UART_RXD
        int "UART RXD pin number"
        range ENV_GPIO_RANGE_MIN ENV_GPIO_IN_RANGE_MAX
        default 22 if IDF_TARGET_ESP32
        default 8 if !IDF_TARGET_ESP32
        help
            GPIO number for UART RX pin. See UART documentation for more information
            about available pin numbers for UART.

    config ECHO_UART_TXD
        int "UART TXD pin number"
        range ENV_GPIO_RANGE_MIN ENV_GPIO_OUT_RANGE_MAX
        default 23 if IDF_TARGET_ESP32
        default 9 if !IDF_TARGET_ESP32
        help
            GPIO number for UART TX pin. See UART documentation for more information
            about available pin numbers for UART.

    config ECHO_UART_RTS
        int "UART RTS pin number"
        range ENV_GPIO_RANGE_MIN ENV_GPIO_OUT_RANGE_MAX
        default 18 if IDF_TARGET_ESP32
        default 10 if !IDF_TARGET_ESP32
        help
            GPIO number for UART RTS pin. This pin is connected to
            ~RE/DE pin of RS485 transceiver to switch direction.
            See UART documentation for more information about available pin
            numbers for UART.

endmenu

menu "Network Configuration"

    config WIFI_ENABLED
        bool "Enable WiFi and SNTP"
        default n
        help
            Connect to a WiFi access point and synchronise the system clock via
            SNTP.  When disabled, the PROFIBUS stack runs without any network
            activity and no WiFi credentials are required.

    config WIFI_SSID
        string "WiFi SSID"
        default ""
        depends on WIFI_ENABLED
        help
            SSID of the WiFi access point to connect to.
            Do not commit this value — set it locally with "idf.py menuconfig".

    config WIFI_PASSWORD
        string "WiFi Password"
        default ""
        depends on WIFI_ENABLED
        help
            WPA/WPA2 passphrase.  Leave empty for open networks.
            Do not commit this value — set it locally with "idf.py menuconfig".

    config SNTP_SERVER
        string "NTP server hostname"
        default "pool.ntp.org"
        depends on WIFI_ENABLED
        help
            Hostname of the NTP server used for time synchronisation.
            pool.ntp.org distributes requests across a global pool of stratum-2
            servers and is suitable for most deployments.

    config SNTP_SYNC_INTERVAL_S
        int "SNTP polling interval (seconds)"
        range 60 86400
        default 3600
        depends on WIFI_ENABLED
        help
            How often the SNTP client contacts the NTP server.

            The ESP32 crystal oscillator drifts ~25-50 ppm.  At the default of
            3600 s (1 hour) the worst-case accumulated drift is ~180 ms, which
            smooth-mode correction (±1 ms/s) resolves in ~3 minutes — imperceptible
            in log timestamps.

            Shorter intervals waste network traffic with little accuracy gain.
            Longer intervals risk multi-second drift and slow smooth corrections.

            Note: this value is clamped to CONFIG_LWIP_SNTP_UPDATE_DELAY (default
            3600 s) by the LWIP stack.  To use a shorter interval, also reduce
            CONFIG_LWIP_SNTP_UPDATE_DELAY via Component config → LWIP → SNTP.

endmenu
```

## sdkconfig.defaults
```kconfig
# sdkconfig.defaults — project-specific build settings.
#
# To set up a local build:
#   1. Run "idf.py menuconfig"
#   2. Network Configuration → Enable WiFi and SNTP → set SSID and Password
#   3. Build normally — do NOT commit sdkconfig

# ----- RS-485 / PROFIBUS UART -----
CONFIG_ECHO_UART_PORT_NUM=2
CONFIG_ECHO_UART_BAUD_RATE=45450
CONFIG_ECHO_UART_RXD=22
CONFIG_ECHO_UART_TXD=23
CONFIG_ECHO_UART_RTS=18

# ----- SNTP -----
CONFIG_SNTP_SERVER="pool.ntp.org"
CONFIG_SNTP_SYNC_INTERVAL_S=3600

# ----- WiFi (credentials are NOT stored here) -----
# CONFIG_WIFI_ENABLED is intentionally absent — defaults to n (disabled).
# Enable it and set credentials locally with "idf.py menuconfig".
```
